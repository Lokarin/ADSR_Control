//!
//! \file           funsapeLibMath.cpp
//! \brief          Math support to Funsape AVR8 Library
//! \author         Leandro Schwarz (bladabuska+funsapeavr8lib@gmail.com)
//! \date           2024-05-08
//! \version        24.05
//! \copyright      license
//! \details        This file ... of the Funsape AVR8 Library
//!

// =============================================================================
// System file dependencies
// =============================================================================

#include "funsapeLibMath.hpp"
#if !defined(__FUNSAPE_LIB_MATH_HPP)
#   error "Header file is corrupted!"
#elif __FUNSAPE_LIB_MATH_HPP != 2407
#   error "Version mismatch between source and header files!"
#endif

#define TABLE_SIZE  360

// =============================================================================
// File exclusive - Constants
// =============================================================================

const uint16_t sineTable[91] = {
    0,  17,  34,  52,  69,  87, 104, 121, 139, 156, 173, 190, 207, 224, 241,
    258, 275, 292, 309, 325, 342, 358, 374, 390, 406, 422, 438, 453, 469, 484,
    499, 515, 529, 544, 559, 573, 587, 601, 615, 629, 642, 656, 669, 681, 694,
    707, 719, 731, 743, 754, 766, 777, 788, 798, 809, 819, 829, 838, 848, 857,
    866, 874, 882, 891, 898, 906, 913, 920, 927, 933, 939, 945, 951, 956, 961,
    965, 970, 974, 978, 981, 984, 987, 990, 992, 994, 996, 997, 998, 999, 999,
    1000
};

// =============================================================================
// File exclusive - New data types
// =============================================================================

// NONE

// =============================================================================
// File exclusive - Global variables
// =============================================================================

// NONE

// =============================================================================
// File exclusive - Macro-functions
// =============================================================================

// NONE

// =============================================================================
// General public functions definitions
// =============================================================================

int16_t integerSine(uint16_t angle_p)
{
    int16_t sineValue = 0;

    angle_p %= 360;

    if(angle_p <= 90) {
        sineValue = (int16_t)(sineTable[angle_p]);
    } else if(angle_p <= 180) {
        sineValue = (int16_t)(sineTable[180 - angle_p]);
    } else if(angle_p < 270) {
        sineValue = -(int16_t)(sineTable[angle_p - 180]);
    } else {
        sineValue = -(int16_t)(sineTable[360 - angle_p]);
    }

    return sineValue;
}



// =============================================================================
// Interrupt callback functions
// =============================================================================

// NONE

// =============================================================================
// Interruption handlers
// =============================================================================

// NONE

// =============================================================================
// END OF FILE
// =============================================================================
